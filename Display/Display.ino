#include <SoftwareSerial.h>  //Do we still need it?
#include <SPI.h>
#include <Adafruit_GFX.h>
#include <Adafruit_PCD8544.h>


/* RFID card reader Pin layout*/
const byte rxPin_SOFT = 4;
const byte txPin_SOFT = 5;
// set up a new serial object
SoftwareSerial RFIDSerial (rxPin_SOFT, txPin_SOFT);
unsigned char buffer[64];
int count=0;
boolean queryFlag = false;
boolean hold = false;

/* PIR Sensor Pin layout*/
#define PIR_MOTION_SENSOR 2  // Uno pin 2 for interrupt

/* Button Pin layout*/
#define PUSH_BUTTON 3       // Uno pin 3 for interrupt

/*Display Pin layout*/
// Software SPI (slower updates, more flexible pin options):
// pin 12 - Serial clock out (SCLK)
// pin 11 - Serial data out (DIN)
// pin 10 - Data/Command select (D/C)
// pin 9 - LCD chip select (CS)
// pin 8 - LCD reset (RST)
Adafruit_PCD8544 display = Adafruit_PCD8544(12, 11, 10, 9, 8);

// Welcome page
// Bitmap sizes for welcomePage
const int welcomePageWidthPages = 10*8;
const int welcomePageHeightPixels = 30;

static const unsigned char PROGMEM welcomePageBitmaps[] =
{
  B00000000, B00000000, B00000000, B11111111, B11000000, B00000000, B00000000, B00000000, B00000000, B00000000, //                         ##########                                           
  B00111111, B11000000, B00000000, B11111111, B11000000, B00000000, B00000000, B00000000, B00000000, B00000000, //   ########              ##########                                           
  B00111111, B11000000, B00000000, B11111111, B11000000, B00000000, B00000000, B00000000, B00000000, B00000000, //   ########              ##########                                           
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  B11111111, B10000000, B00000000, B00000000, B00000000, B00000000, B00000000, B00000000, B00000000, B00000000, // #########                                                                    
                                                                    
};


// Selfie Image
// Bitmap sizes for selfieTime
const int selfieTimeWidthPages = 7*8;
const int selfieTimeHeightPixels = 42;

static const unsigned char PROGMEM selfieBMP[] = {
  B01111000, B00000100, B10000000, B00001111, B10000000, B00000000, B00100100, //  ####        #  #           #####                 #  #
  B10000100, B00000101, B00100000, B00000010, B00100000, B00000000, B00100100, // #    #       # #  #           #   #               #  #
  B10000000, B00000101, B00000000, B00000010, B00000000, B00000000, B00100100, // #            # #              #                   #  #
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  B00000000, B00111111, B11111111, B11111111, B11111111, B11100000, B00000000, //           #################################           
};
  
void setup() {
  // serial port for display
  Serial.begin(9600);
  RFIDSerial.begin(9600);

  displayInit();
  PIRInit();
  PushButtonInit();
}

// Define varibles
int incomingByte =0;
int incomingNum = 0;   // For serial input to the display
int displayNum=0;     // Number sending to nokia display
String incomingData;

void loop() {
  /*For Display*/
  while(Serial.available()>0){
    incomingData = String(Serial.read());   // Convert the input data to ascii
    Serial.println(incomingData);
    
    // Check for serial input: For display
    incomingNum = incomingData.toInt();
    if(incomingNum>=48 && incomingNum<=57){ // Check if the input is from 0~9
      displayNum = incomingNum-48;
      displayNokia(displayNum);
    }
    else{
      displayWelcomePage();
    }
  }
  /*For RDIF reader*/
   while(RFIDSerial.available()){
      buffer[count++]=RFIDSerial.read();
      if(count == 64){
        Serial.print("RFIDdata:");   //When it read the RFID data, printed through serial line
        Serial.write(buffer,count);
        clearBufferArray();
        count = 0;
        break;
      }
   }
}
/**********************************/
void displayInit(void){
  // Display setting
  display.begin();
  display.setContrast(50);
  display.clearDisplay();

  // Set text size
  display.setTextSize(6);
  display.setTextColor(BLACK);

  // Display welcome page
  displayWelcomePage();
}
/**********************************/
void PIRInit(void){
  pinMode(PIR_MOTION_SENSOR, INPUT);
  attachInterrupt(digitalPinToInterrupt(PIR_MOTION_SENSOR), UpdataPIR, RISING);
}
void UpdataPIR(){// Interrupt service routing ISR for PIR sensor
    Serial.println("PIRon");
}
/**********************************/
void PushButtonInit(void){
  pinMode(PUSH_BUTTON,OUTPUT);
  attachInterrupt(digitalPinToInterrupt(PUSH_BUTTON), UpdataPUSHBUTTON, RISING);
}
void UpdataPUSHBUTTON(void){
  Serial.println("BTon");
}
/**********************************/
void displayNokia(int inNum){
    display.clearDisplay();
    // Reminder to take selfie
    if(inNum == 9){
      display.clearDisplay();
      display.drawBitmap(14, 4,  selfieBMP, selfieTimeWidthPages, selfieTimeWidthPages, 1);
      display.display();
    }
    // Normal display from 0-8
    else{
      display.setCursor(24,3);
      display.println(String(inNum));
      display.display();
    }
}
void displayWelcomePage(void){
  display.clearDisplay();
  display.drawBitmap(1, 9,  welcomePageBitmaps, welcomePageWidthPages, welcomePageHeightPixels, 1);
  display.display();
}
/**********************************/
void clearBufferArray(){
  for (int i=0;i<count;i++)
    buffer[i]=NULL;
}
